## conf/layer.conf
```bitbake
# We have a conf and classes directory, add to BBPATH
BBPATH .= ":${LAYERDIR}"

# We have recipes-* directories, add to BBFILES
BBFILES += "${LAYERDIR}/recipes-*/*/*.bb \
            ${LAYERDIR}/recipes-*/*/*.bbappend"

BBFILE_COLLECTIONS += "meta-readonly-overlayfs"
BBFILE_PATTERN_meta-readonly-overlayfs = "^${LAYERDIR}/"
BBFILE_PRIORITY_meta-readonly-overlayfs = "6"

LAYERSERIES_COMPAT_meta-readonly-overlayfs = "sumo"
```
